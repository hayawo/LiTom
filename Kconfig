## Kconfig
```kconfig
config LITOM_PREFER_USB_ENDPOINT_ON_READY
    bool "Prefer USB endpoint when USB HID is ready"
    depends on ZMK_USB && ZMK_BLE
    help
      Switch the selected ZMK output endpoint back to USB whenever the USB HID
      endpoint becomes ready. This keeps BLE enabled for split transport while
      making host input prefer USB when a cable is connected.

config LITOM_BLE_CONN_PARAM_REFRESH
    bool "Re-request preferred BLE connection parameters when the host slows the link"
    depends on ZMK_BLE && (!ZMK_SPLIT || ZMK_SPLIT_ROLE_CENTRAL)
    help
      Zephyr requests the preferred connection parameters only once after
      connecting. If the host later lengthens the connection interval (for
      example while the display is off), pointer reports back up in the BLE
      HID queue. Request the preferred parameters again when ZMK becomes
      active and when the host switches to a slower interval.

config LITOM_AUTO_MOUSE_LAYER
    bool "LiTom trackball auto mouse layer"
    depends on INPUT
    help
      Activate a temporary mouse layer from trackball movement without using
      the generic temp-layer input processor.

if LITOM_AUTO_MOUSE_LAYER

config LITOM_AUTO_MOUSE_LAYER_TARGET
    int "Auto mouse layer index"
    default 1

config LITOM_AUTO_MOUSE_LAYER_SCROLL
    int "Scroll layer index that pauses auto mouse layer deactivation"
    default 2

config LITOM_AUTO_MOUSE_LAYER_TIMEOUT_MS
    int "Auto mouse layer timeout in milliseconds"
    default 400

module = LITOM_AUTO_MOUSE_LAYER
module-str = litom_auto_mouse_layer
source "${ZEPHYR_BASE}/subsys/logging/Kconfig.template.log_config"

endif
```

## config/west.yml
```yaml
manifest:
  remotes:
    - name: cormoran
      url-base: https://github.com/cormoran
    - name: badjeff
      url-base: https://github.com/badjeff
    - name: pukuhei
      url-base: https://github.com/pukuhei
    - name: mjmjm0101
      url-base: https://github.com/mjmjm0101
    - name: hayawo
      url-base: https://github.com/hayawo
  projects:
    - name: zmk
      remote: cormoran
      revision: v0.3-branch+dya
      import: app/west.yml
    - name: zmk-module-ble-management
      remote: cormoran
      revision: zmk-v0.3.0.0
    - name: zmk-module-battery-history
      remote: cormoran
      revision: 307755dd2ad4d320e14de162e8e5ef018f29d929
    - name: zmk-module-settings-rpc
      remote: cormoran
      revision: zmk-v0.3.0.0
    # cormoran/zmk-module-runtime-input-processor の zmk-v0.3.0.0 に、
    # scale_val() の int16 オーバーフロー修正だけを載せたフォーク。
    # 本家は掛け算の結果を int16_t で受けているため、Studio で 1.00x 以外の
    # 倍率にすると速い動きでカーソル / スクロールが逆方向へ飛ぶ。
    # 本家が修正されたら remote: cormoran に戻すこと。
    - name: zmk-module-runtime-input-processor
      remote: hayawo
      revision: fix/scale-val-int16-overflow
    - name: zmk-behavior-runtime-sensor-rotate
      remote: cormoran
      revision: zmk-v0.3.0.0
    - name: zmk-pmw3610-driver
      remote: badjeff
      revision: zmk-0.3
    # 本家 pukuhei/zmk-tom-oled は 2026-08-13 に ZMK v0.4 へ移行し、LVGL v9 の
    # 型 (lv_draw_buf_t) を使い始めたため main では v0.3 (LVGL v8) の本リポジトリ
    # でビルドできない。v0.3 対応の最終コミット bbfe719 を基点にしたフォークで、
    # HID インジケータの有効化と peripheral のバッテリー表示を追加している。
    # ZMK を v0.4 へ上げる際は、本家の v0.4 版へこの差分を載せ直すこと。
    - name: zmk-tom-oled
      remote: hayawo
      revision: fix/hid-indicators-and-peripheral-battery
    # 可動ブランチを指すと本家の更新で不意にビルドが壊れるため SHA で固定する。
    - name: zmk-input-processor-scroll-inertia
      remote: mjmjm0101
      revision: f7dadefee453d555fe066d13a3de3bb60739b45e
  self:
    path: config
```

## dts/bindings/litom,input-processor-spike-filter.yaml
```yaml
description: |
  Input processor that drops physically impossible pointer deltas.

  The PMW3610 occasionally returns garbage motion right after the sensor
  wakes from its rest modes: a burst of values close to the 12 bit range
  (+-2047) with randomly alternating signs. On the host this throws the
  cursor across the screen.

  Measured on LiTom (600 cpi, one report per 16ms): normal motion is 20-80
  counts per report and a fast flick peaks around 200. A recorded burst
  after 3 minutes of no trackball use contained 11 reports within 165ms
  with values up to 1575.

  Any event above max-delta is zeroed, and every tracked event within
  suppress-ms after it is zeroed as well, so the remainder of a burst is
  swallowed too. Place it first in the input-processors chain, before any
  scaling, so the thresholds refer to raw sensor counts.

compatible: "litom,input-processor-spike-filter"

properties:
  "#input-processor-cells":
    type: int
    required: true
    const: 0

  track-remainders:
    type: boolean
    description: Unused; declared so the listener macros can read it.

  type:
    type: int
    default: 2 # INPUT_EV_REL
    description: Input event type to filter.

  codes:
    type: array
    required: true
    description: Event codes to filter (typically INPUT_REL_X and INPUT_REL_Y).

  max-delta:
    type: int
    default: 600
    description: |
      Absolute value above which an event is treated as a spike. Keep it
      well above the fastest real flick so normal use is never clipped.

  suppress-ms:
    type: int
    default: 250
    description: |
      After a spike, zero every tracked event for this long. Bursts arrive
      as several reports, and the later ones can be small enough to pass
      the max-delta check on their own.
```
